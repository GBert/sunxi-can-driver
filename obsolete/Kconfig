## obsolete/Kconfig
```kconfig
config CAN_SUNXI
        tristate "Sun7i CAN bus controller"
        default n
        help
        This is the Sun7i CAN BUS driver for android system by peter chen.
```
